## conf/machine/include/qoriq-arm.inc
```bitbake
# Provides the QorIQ common settings for ARM
require conf/machine/include/soc-family.inc

KERNEL_IMAGETYPE ?= "uImage"

MACHINEOVERRIDES =. "qoriq-arm:"

require conf/machine/include/qoriq.inc
```

## conf/machine/include/qoriq-arm64.inc
```bitbake
# Provides the QorIQ common settings for ARM64
require conf/machine/include/soc-family.inc

KERNEL_IMAGETYPE ?= "Image"

BBMASK = ".*openjre|.*openjdk"

MACHINEOVERRIDES =. "qoriq-arm64:"

require conf/machine/include/qoriq.inc
```

## conf/machine/include/qoriq.inc
```bitbake
# Provides the QorIQ common settings

PREFERRED_PROVIDER_virtual/kernel ?= "linux-qoriq"
PREFERRED_PROVIDER_virtual/bootloader ?= "u-boot-qoriq"
PREFERRED_PROVIDER_u-boot ?= "u-boot-qoriq"

MACHINE_EXTRA_RRECOMMENDS += "udev-extraconf kernel-modules"

IMAGE_CLASSES += "image_types_uboot"
EXTRA_IMAGEDEPENDS += "u-boot"

MACHINEOVERRIDES =. "qoriq:"
```

## conf/machine/ls1043ardb.conf
```bitbake
#@TYPE: Machine
#@NAME: Freescale LS1043ARDB 
#@SOC: LSCH2
#@DESCRIPTION: Machine configuration for running LS1043A in 64-bit mode
#@MAINTAINER: Chunrong Guo <nxa13725@nxp.com>

require conf/machine/include/qoriq-arm64.inc
require conf/machine/include/arm/arch-arm64.inc

SOC_FAMILY = "fsl-lsch2"

UBOOT_CONFIG ??= "nand sdcard nor"
UBOOT_CONFIG[nor] = "ls1043ardb_config"
UBOOT_CONFIG[nand] = "ls1043ardb_nand_config"
UBOOT_CONFIG[sdcard] = "ls1043ardb_sdcard_config"
UBOOT_CONFIG[secure-boot] = "ls1043ardb_SECURE_BOOT_defconfig"

QE_UCODE = "iram_Type_A_LS1021a_r1.0.bin"

KERNEL_DEFCONFIG ?= "${S}/arch/arm64/configs/defconfig"
KERNEL_DEVICETREE ?= "freescale/fsl-ls1043a-rdb.dtb freescale/fsl-ls1043a-rdb-usdpaa.dtb"

SERIAL_CONSOLES ?= "115200;ttyS0 115200;ttyAMA0"
SERIAL_CONSOLES_CHECK ?= "${SERIAL_CONSOLES}"

EXTRA_IMAGEDEPENDS += "fm-ucode rcw ppa qe-ucode"
USE_VT = "0"
```

## conf/machine/ls2080ardb.conf
```bitbake
#@TYPE: Machine
#@NAME: Freescale LS2080ARDB board
#@SOC: LSCH3
#@DESCRIPTION: Machine configuration for running LS2080ARDB in 64-bit mode
#@MAINTAINER: Zongchun Yu <Zongchun.Yu@nxp.com>

require conf/machine/include/qoriq-arm64.inc
require conf/machine/include/arm/arch-arm64.inc

SOC_FAMILY = "fsl-lsch3"

UBOOT_CONFIG ??= "nor"
UBOOT_CONFIG[nor] = "ls2080ardb_defconfig"

KERNEL_DEFCONFIG ?= "${S}/arch/arm64/configs/defconfig"
KERNEL_DEVICETREE ?= "freescale/fsl-ls2080a-rdb.dtb"

SERIAL_CONSOLES ?= "115200;ttyS0 115200;ttyS1 115200;ttyAMA0"
SERIAL_CONSOLES_CHECK ?= "${SERIAL_CONSOLES}"

EXTRA_IMAGEDEPENDS += "dpl-examples ls2-phy ls2-rcw management-complex"
USE_VT = "0"
```
